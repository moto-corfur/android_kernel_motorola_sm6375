## drivers/input/touchscreen/focaltech_v2_mmi/Kconfig
```kconfig
#
# Focaltech Touchscreen driver configuration
#

config TOUCHSCREEN_FOCALTECH_V2_MMI
	tristate "Focaltech V2 MMI Touchscreen"
	depends on I2C
	default n
	help
	  Say Y here if you have Focaltech V2 MMI touch panel.
	  If unsure, say N.

	  To compile this driver as a module, choose M here: the
	  module will be called focaltech_v2_mmi.

config INPUT_FOCALTECH_MMI_ENABLE_DOUBLE_TAP
	bool "Enable double tap"
	depends on TOUCHSCREEN_FOCALTECH_V2_MMI
	default n
	help
	  Say Y here to enable double tap functionality on Focaltech V2 MMI touch panel.
	  If unsure, say N.
```

## drivers/input/touchscreen/goodix_gtx8_v1510_mmi/Kconfig
```kconfig
#
# Goodix touchscreen driver configuration
#

config TOUCHSCREEN_GOODIX_GTX8_V1510_MMI
	tristate "Goodix GTx8 V1510 touchscreen"
	depends on I2C
	default n
	help
	  Say Y here if you have a Goodix GTx8 V1510 touchscreen connected
	  to your system.

	  If unsure, say N.

	  To compile this driver as a module, choose M here: the
	  module will be called goodix_v1510_mmi.
```

## drivers/nfc/st21nfc/Kconfig
```kconfig
config NFC_ST21NFC
	tristate "STMicroelectronics ST21NFC driver"
	depends on I2C
	default n
	help
	  Say Y here if you have an STMicroelectronics ST21NFC controller connected to your system.

	  To compile this driver as a module, choose M here: the
	  module will be called st21nfc.
```

## drivers/power/mmi_sc8549/Kconfig
```kconfig
config MMI_SC8549
	tristate "Southchip SC8549 charge pump driver"
	depends on I2C
	default n
	help
	  Say Y here to enable Southchip SC8549 charge pump driver.

	  To compile this driver as a module, choose M here: the
	  module will be called mmi_sc8549.
```
